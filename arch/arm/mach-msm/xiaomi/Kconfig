## arch/arm/mach-msm/xiaomi/Kconfig
```kconfig
config MACH_XIAOMI
	bool

menu "XIAOMI Board Selection"
source "arch/arm/mach-msm/xiaomi/Kconfig.board"
endmenu


menu "XIAOMI Specific Patches"

config UPDATE_LCDC_LUT
	bool "Set initial Qualcomm LCDC lut"
	default n
	depends on MACH_XIAOMI
	help
	  Set initial Qualcomm LCDC Look Up Table.

config LCD_KCAL
	bool "Interface to calibrate LCD color temperature"
	default n
	depends on MACH_XIAOMI && UPDATE_LCDC_LUT
	help
	  Interface to calibrate LCD color temperature


config XIAOMI_EARJACK_UART
	bool "Earjack UART"
	default n
	depends on MACH_XIAOMI
	help
	  Enable Earjack UART debugger. This disables headphone support

endmenu
```

## arch/arm/mach-msm/xiaomi/Kconfig.board
```kconfig
#
# Inlcude the specific Kconfig file for XIAOMI board
#
# ARIES
source "arch/arm/mach-msm/xiaomi/aries/Kconfig"

config MACH_XIAOMI_DUMMY
	bool "NONE (No device)"
```

## arch/arm/mach-msm/xiaomi/aries/Kconfig
```kconfig
config MACH_APQ8064_ARIES
	depends on ARCH_APQ8064
	select MACH_XIAOMI
	bool "MSM8064 ARIES"
	help
	  Support for the XIAOMI ARIES device.
```
